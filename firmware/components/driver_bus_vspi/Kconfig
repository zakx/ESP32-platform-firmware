## firmware/components/driver_bus_vspi/Kconfig
```kconfig
menu "Driver: VSPI bus"
	config DRIVER_VSPI_ENABLE
		bool "Enable the VSPI bus driver"
		default n
		
	config PIN_NUM_VSPI_CLK
		depends on DRIVER_VSPI_ENABLE
		int "GPIO pin used for CLK"
		
	config PIN_NUM_VSPI_MOSI
		depends on DRIVER_VSPI_ENABLE
		int "GPIO pin used for MOSI"
		
	config PIN_NUM_VSPI_MISO
		depends on DRIVER_VSPI_ENABLE
		int "GPIO pin used for MISO"
	
	config VSPI_MAX_TRANSFERSIZE
		depends on DRIVER_VSPI_ENABLE
		int "Maximum transfer size"
		default 4094
	
	config VSPI_DMA
		depends on DRIVER_VSPI_ENABLE
		int "DMA channel"
		range 0 2
		default 2
	
	
endmenu
```

## firmware/components/driver_sdcard/Kconfig
```kconfig
menu "Driver: SD card"
	config DRIVER_SDCARD_ENABLE
		depends on DRIVER_VSPI_ENABLE
		bool "Enable the SD card driver"
		default n
		
	config PIN_NUM_SDCARD_CS
		depends on DRIVER_SDCARD_ENABLE
		int "GPIO pin used for CS"
endmenu
```
